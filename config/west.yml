## config/west.yml
```yaml
manifest:
  remotes:
    - name: HeavyDutySoul
      url-base: https://github.com/HeavyDutySoul
    - name: oleksandrmaslov
      url-base: https://github.com/oleksandrmaslov
  projects:
    - name: zmk
      remote: HeavyDutySoul
      revision: feat/battery-reporting
      import: app/west.yml
    - name: zmk-soft-off-plus
      remote: oleksandrmaslov
      revision: main
  self:
    path: config
```
