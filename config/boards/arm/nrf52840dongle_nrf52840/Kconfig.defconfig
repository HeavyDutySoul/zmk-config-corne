## config/boards/arm/nrf52840dongle_nrf52840/Kconfig.defconfig
```kconfig
# nRF52840 Dongle NRF52840 board configuration
#
# Copyright (c) 2018 Nordic Semiconductor ASA
#
# SPDX-License-Identifier: Apache-2.0

if BOARD_NRF52840DONGLE_NRF52840

config BOARD
	default "nrf52840dongle_nrf52840"

config BT_CTLR
	default BT

if USB_DEVICE_STACK

# Enable UART driver, needed for CDC ACM
config SERIAL
  default y

endif # USB_DEVICE_STACK

endif # BOARD_NRF52840DONGLE_NRF52840
```

## config/boards/arm/nrf52840dongle_nrf52840/nrf52840dongle_nrf52840_defconfig
```kconfig
# SPDX-License-Identifier: Apache-2.0

CONFIG_SOC_SERIES_NRF52X=y
CONFIG_SOC_NRF52840_QIAA=y
CONFIG_BOARD_NRF52840DONGLE_NRF52840=y

# Enable MPU
CONFIG_ARM_MPU=y

# Enable hardware stack protection
CONFIG_HW_STACK_PROTECTION=y

CONFIG_USB_DEVICE_STACK=y
CONFIG_USB_NRFX=y
CONFIG_SERIAL=y
CONFIG_USB_CDC_ACM=y
CONFIG_DT_HAS_ZEPHYR_CDC_ACM_UART_ENABLED=y

CONFIG_NRF_STORE_REBOOT_TYPE_GPREGRET=n

# enable GPIO
CONFIG_GPIO=y

CONFIG_USE_DT_CODE_PARTITION=y
CONFIG_BUILD_OUTPUT_UF2=y

CONFIG_MPU_ALLOW_FLASH_WRITE=y
CONFIG_NVS=y
CONFIG_SETTINGS_NVS=y
CONFIG_FLASH=y
CONFIG_FLASH_PAGE_LAYOUT=y
CONFIG_FLASH_MAP=y

CONFIG_ZMK_USB=y
CONFIG_ZMK_BLE=y
```
